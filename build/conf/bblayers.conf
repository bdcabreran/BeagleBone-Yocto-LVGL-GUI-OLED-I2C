## build/conf/bblayers.conf
```bitbake
# POKY_BBLAYERS_CONF_VERSION is increased each time build/conf/bblayers.conf
# changes incompatibly
POKY_BBLAYERS_CONF_VERSION = "2"

BBPATH = "${TOPDIR}"
BBFILES ?= ""

BBLAYERS ?= " \
  /yocto/sources/meta-custom \
  /yocto/sources/poky/meta \
  /yocto/sources/poky/meta-poky \
  /yocto/sources/poky/meta-yocto-bsp \
  /yocto/sources/meta-openembedded/meta-oe \
  /yocto/sources/meta-openembedded/meta-networking \
  /yocto/sources/meta-openembedded/meta-python \
  "
```
